## firmware/espidf/esp32-s3-a7670e/docs/vendor/esp32-s3-a7670e/demo/Demo_V2_After_December_2025/ESP32-S3-A-SIM7670X-4G-V2/ESP-IDF/ESP32-S3-XXX7670X-4G-GNSS/sdkconfig.defaults
```kconfig
CONFIG_IDF_TARGET="esp32s3"
CONFIG_APP_UART_PORT_NUM=1
CONFIG_APP_UART_BAUD_RATE=115200
CONFIG_APP_UART_RXD=17
CONFIG_APP_UART_TXD=18
CONFIG_APP_UART_BUF_SIZE=1024
CONFIG_APP_RESPONSE_TIMEOUT_MS=2000
CONFIG_APP_TASK_STACK_SIZE=4096
```

## firmware/espidf/esp32-s3-a7670e/docs/vendor/esp32-s3-a7670e/demo/Demo_V2_After_December_2025/ESP32-S3-A-SIM7670X-4G-V2/ESP-IDF/ESP32-S3-XXX7670X-4G-HTTP/main/Kconfig.projbuild
```kconfig
menu "UART AT Example Configuration"

    orsource "$IDF_PATH/examples/common_components/env_caps/$IDF_TARGET/Kconfig.env_caps"

    config APP_UART_PORT_NUM
        int "UART port number"
        range 0 2 if IDF_TARGET_ESP32 || IDF_TARGET_ESP32S3
        default 1 if IDF_TARGET_ESP32 || IDF_TARGET_ESP32S3
        range 0 1
        default 1
        help
            UART port used to communicate with the modem.
            Note: UART0 is often used by console/USB-Serial-JTAG.
            Using UART1 is recommended for modem communication.

    config APP_UART_BAUD_RATE
        int "UART baud rate"
        range 1200 3000000
        default 115200
        help
            UART communication speed for modem AT commands.

    config APP_UART_RXD
        int "UART RXD GPIO"
        range ENV_GPIO_RANGE_MIN ENV_GPIO_IN_RANGE_MAX
        default 17
        help
            GPIO number for UART RX pin (ESP32-S3 typical: 17).

    config APP_UART_TXD
        int "UART TXD GPIO"
        range ENV_GPIO_RANGE_MIN ENV_GPIO_OUT_RANGE_MAX
        default 18
        help
            GPIO number for UART TX pin (ESP32-S3 typical: 18).

    config APP_UART_BUF_SIZE
        int "UART buffer size"
        range 256 4096
        default 1024
        help
            UART RX temporary buffer size used to receive AT responses.

    config APP_RESPONSE_TIMEOUT_MS
        int "AT response timeout (ms)"
        range 100 60000
        default 2000
        help
            Timeout for waiting expected response string, in milliseconds.

    config APP_TASK_STACK_SIZE
        int "Main task stack size"
        range 2048 16384
        default 4096
        help
            Stack size for app_main task. Increase if you add more parsing or features.

endmenu
```

## firmware/espidf/esp32-s3-a7670e/main/Kconfig.projbuild
```kconfig
menu "Unified Firmware Main"

config UNIFIED_TASK_REGISTRY_CAPACITY
    int "Task registry capacity"
    range 8 64
    default 24

config UNIFIED_HEALTH_MODULE_CAPACITY
    int "Health module registry capacity"
    range 8 64
    default 32

config UNIFIED_TASK_STACK_SMALL
    int "Small task stack size"
    range 3072 8192
    default 4096

config UNIFIED_TASK_STACK_MEDIUM
    int "Medium task stack size"
    range 4096 12288
    default 6144

config UNIFIED_TASK_STACK_LARGE
    int "Large task stack size"
    range 6144 16384
    default 8192

config UNIFIED_TASK_STACK_XLARGE
    int "Extra large task stack size"
    range 8192 24576
    default 12288

config UNIFIED_HEALTH_INTERVAL_MS
    int "Health interval ms"
    range 1000 60000
    default 5000

config UNIFIED_DIAGNOSTICS_INTERVAL_MS
    int "Diagnostics interval ms"
    range 1000 60000
    default 5000

config UNIFIED_DEVICE_STATUS_INTERVAL_MS
    int "Device status serial snapshot interval ms"
    range 5000 300000
    default 15000

config UNIFIED_WIFI_DISABLE_POWER_SAVE
    bool "Disable Wi-Fi modem sleep power save for stability"
    default y

config UNIFIED_MODEM_UART_PORT
    int "Modem UART port number"
    range 1 2
    default 1

config UNIFIED_MODEM_UART_BAUD_RATE
    int "Modem UART baud rate"
    range 9600 921600
    default 115200

config UNIFIED_MODEM_UART_RX_BUFFER
    int "Modem UART RX buffer size"
    range 256 4096
    default 4096

config UNIFIED_MODEM_AT_TIMEOUT_MS
    int "Modem AT command timeout ms"
    range 250 20000
    default 3000

config UNIFIED_MODEM_PROBE_INTERVAL_MS
    int "Modem probe interval ms"
    range 1000 60000
    default 5000

config UNIFIED_MODEM_EVENT_QUEUE_DEPTH
    int "Modem event queue depth"
    range 2 32
    default 8

config UNIFIED_STORAGE_RECORD_CAPACITY
    int "Storage record spool capacity"
    range 8 128
    default 32

config UNIFIED_STORAGE_MOUNT_RETRY_MS
    int "Storage SD mount retry interval ms"
    range 1000 60000
    default 15000

config UNIFIED_STORAGE_TASK_STACK_SIZE
    int "Storage task stack size"
    range 8192 24576
    default 16384

config UNIFIED_STORAGE_MAX_OPEN_FILES
    int "Storage max open files"
    range 2 16
    default 8

config UNIFIED_API_BRIDGE_HISTORY_DEPTH
    int "API bridge recent action history depth"
    range 4 32
    default 8

config UNIFIED_API_BRIDGE_PAYLOAD_LEN
    int "API bridge payload buffer length"
    range 256 4096
    default 3072

config UNIFIED_AUTOMATION_QUEUE_DEPTH
    int "Automation bridge queue depth"
    range 2 32
    default 16

config UNIFIED_AUTOMATION_TOPIC_LEN
    int "Automation bridge topic buffer length"
    range 64 256
    default 128

config UNIFIED_AUTOMATION_MESSAGE_LEN
    int "Automation bridge message buffer length"
    range 128 2048
    default 2048

config UNIFIED_TELEPHONY_POLL_INTERVAL_MS
    int "Telephony poll interval ms"
    range 1000 60000
    default 5000

config UNIFIED_TELEPHONY_ACTION_TIMEOUT_MS
    int "Telephony action timeout ms"
    range 1000 120000
    default 15000

config UNIFIED_WIFI_DEFER_STARTUP_CONNECT
    bool "Defer Wi-Fi startup connect until explicitly released"
    default n

endmenu
```

## firmware/espidf/esp32-s3-a7670e/sdkconfig.defaults
```kconfig
CONFIG_IDF_TARGET="esp32s3"
CONFIG_ESPTOOLPY_FLASHSIZE_16MB=y
CONFIG_FREERTOS_UNICORE=n
CONFIG_ESP_MAIN_TASK_STACK_SIZE=8192
CONFIG_PARTITION_TABLE_CUSTOM=y
CONFIG_PARTITION_TABLE_CUSTOM_FILENAME="partitions.csv"
CONFIG_PARTITION_TABLE_FILENAME="partitions.csv"
CONFIG_COMPILER_OPTIMIZATION_SIZE=y
CONFIG_BOOTLOADER_COMPILER_OPTIMIZATION_SIZE=y
CONFIG_NEWLIB_NANO_FORMAT=y
CONFIG_LOG_DEFAULT_LEVEL_INFO=y
CONFIG_LOG_MAXIMUM_LEVEL_INFO=y
CONFIG_BOOTLOADER_LOG_LEVEL_WARN=y
CONFIG_SPIRAM=y
CONFIG_SPIRAM_MODE_OCT=y
CONFIG_SPIRAM_TYPE_AUTO=y
CONFIG_SPIRAM_SPEED_80M=y
CONFIG_SPIRAM_BOOT_INIT=y
CONFIG_SPIRAM_USE_MALLOC=y
CONFIG_SPIRAM_MALLOC_RESERVE_INTERNAL=32768
CONFIG_BOOTLOADER_APP_ROLLBACK_ENABLE=y
CONFIG_UNIFIED_TASK_REGISTRY_CAPACITY=24
CONFIG_UNIFIED_HEALTH_MODULE_CAPACITY=32
CONFIG_UNIFIED_TASK_STACK_SMALL=4096
CONFIG_UNIFIED_TASK_STACK_MEDIUM=8192
CONFIG_UNIFIED_TASK_STACK_LARGE=8192
CONFIG_UNIFIED_TASK_STACK_XLARGE=12288
CONFIG_UNIFIED_HEALTH_INTERVAL_MS=5000
CONFIG_UNIFIED_DIAGNOSTICS_INTERVAL_MS=5000
CONFIG_UNIFIED_STORAGE_RECORD_CAPACITY=32
CONFIG_UNIFIED_STORAGE_MOUNT_RETRY_MS=15000
CONFIG_UNIFIED_STORAGE_TASK_STACK_SIZE=16384
CONFIG_UNIFIED_STORAGE_MAX_OPEN_FILES=8
CONFIG_UNIFIED_WIFI_DISABLE_POWER_SAVE=y
CONFIG_UNIFIED_MODEM_UART_PORT=1
CONFIG_UNIFIED_MODEM_UART_BAUD_RATE=115200
CONFIG_UNIFIED_MODEM_UART_RX_BUFFER=4096
CONFIG_UNIFIED_MODEM_AT_TIMEOUT_MS=3000
CONFIG_UNIFIED_MODEM_PROBE_INTERVAL_MS=5000
CONFIG_UNIFIED_AUTOMATION_QUEUE_DEPTH=16
```
